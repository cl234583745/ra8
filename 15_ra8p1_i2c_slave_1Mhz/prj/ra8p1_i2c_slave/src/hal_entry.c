#include "hal_data.h"

#if (1 == BSP_MULTICORE_PROJECT) && BSP_TZ_SECURE_BUILD
bsp_ipc_semaphore_handle_t g_core_start_semaphore =
{
    .semaphore_num = 0
};
#endif

/*******************************************************************************************************************//**
 * main() is generated by the RA Configuration editor and is used to generate threads if an RTOS is used.  This function
 * is called by main() when no RTOS is used.
 **********************************************************************************************************************/
void hal_entry(void)
{
    /* TODO: add your own code here */
    R_IIC_SLAVE_Open(&g_i2c_slave_ctrl, g_i2c_slave.p_cfg);

    while(1)
    {
        static bool level = 0;
        R_IOPORT_PinWrite(&IOPORT_CFG_CTRL, BSP_IO_PORT_06_PIN_00, level=!level);

        R_BSP_SoftwareDelay(1000, 1000);
    }
    /* Wake up 2nd core if this is first core and we are inside a multicore project. */
#if (0 == _RA_CORE) && (1 == BSP_MULTICORE_PROJECT) && !BSP_TZ_NONSECURE_BUILD

#if BSP_TZ_SECURE_BUILD
    /* Take semaphore so 2nd core can clear it */
    R_BSP_IpcSemaphoreTake(&g_core_start_semaphore);
#endif

    R_BSP_SecondaryCoreStart();

#if BSP_TZ_SECURE_BUILD
    /* Wait for 2nd core to start and clear semaphore */
    while(FSP_ERR_IN_USE == R_BSP_IpcSemaphoreTake(&g_core_start_semaphore))
    {
        ;
    }
#endif
#endif

#if (1 == _RA_CORE) && (1 == BSP_MULTICORE_PROJECT) && BSP_TZ_SECURE_BUILD
    /* Signal to 1st core that 2nd core has started */
    R_BSP_IpcSemaphoreGive(&g_core_start_semaphore);
#endif

#if BSP_TZ_SECURE_BUILD
    /* Enter non-secure code */
    R_BSP_NonSecureEnter();
#endif
}
#define BUF_LEN            5
static uint8_t g_slave_rx_buf[BUF_LEN] = {0xaa,0xbb,0xcc,0xdd,0xee};
static uint8_t g_slave_tx_buf[BUF_LEN] = {0x00,0x11,0x22,0x33,0x44};
void g_i2c_slave0CB(i2c_slave_callback_args_t * p_args)
{
    fsp_err_t err = FSP_SUCCESS;

    if (NULL != p_args)
    {
        switch (p_args->event)
        {
            case I2C_SLAVE_EVENT_RX_REQUEST:
            {
                R_IIC_SLAVE_Read(&g_i2c_slave_ctrl, g_slave_rx_buf, BUF_LEN);
                break;
            }
            //已经自定义usr_iic_slave_txi_isr，不再走该case
            case I2C_SLAVE_EVENT_TX_REQUEST:
            {
                err = R_IIC_SLAVE_Write(&g_i2c_slave_ctrl, g_slave_tx_buf, BUF_LEN);
                break;
            }
            default:
                break;
        }
    }
 }


/*
 * 通过fsp增加自定义中断函数，防止直接修改fsp代码被生成代码顶替
 * configuration.xml->Interrupts->New User Event->选择对应中断例如IIC1 TXI，自定义中断函数名usr_iic_slave_txi_isr
 */
void usr_iic_slave_txi_isr (void)
{
    /* Save context if RTOS is used */
    FSP_CONTEXT_SAVE

    /* Bit position for the START condition detection flag in ICSR2 */
    #define ICSR2_START_BIT                                    (0x04U)
    /* Bit position for STOP condition flag in ICSR2 */
    #define ICSR2_STOP_BIT                                     (0x08U)
    /* The start condition detection interrupt enable bit */
    #define IIC_STR_EN_BIT                                     (0x04U)
    /* The stop condition detection interrupt enable bit */
    #define IIC_STP_EN_BIT                                     (0x08U)
    /* The timeout interrupt enable bit */
    #define IIC_TMO_EN_BIT                                     (0x01U)
    /* The arbitration loss detection interrupt enable bit */
    #define IIC_ALD_EN_BIT                                     (0x02U)
    /* The NAK reception interrupt enable bit */
    #define IIC_NAK_EN_BIT                                     (0x10U)
    /* The receive data full interrupt enable bit */
    #define IIC_RXI_EN_BIT                                     (0x20U)
    /* The transmit data empty interrupt enable bit */
    #define IIC_TXI_EN_BIT                                     (0x80U)

    R_BSP_IrqStatusClear(R_FSP_CurrentIrqGet());

    iic_slave_instance_ctrl_t * p_ctrl = &g_i2c_slave_ctrl;

    /* TXI only serves a master-read. Two cases here:
     *   1) First TXI of this transaction (direction not yet registered as MASTER_READ)
     *   2) Stale state left by the previous write's end-of-transaction race
     *      (do_dummy_read stuck, RX DTC possibly armed by a phantom RX_REQUEST). */
    if (IIC_SLAVE_TRANSFER_DIR_MASTER_READ_SLAVE_WRITE != p_ctrl->direction)
    {
        /* Kill any stray RX DTC transfer and its activation flag, and clear the stale
         * address-match flag so the next transaction's RXI uses the correct path. */
        if (NULL != p_ctrl->p_cfg->p_transfer_rx)
        {
            p_ctrl->p_cfg->p_transfer_rx->p_api->disable(p_ctrl->p_cfg->p_transfer_rx->p_ctrl);
        }
        p_ctrl->activation_on_rxi = false;
        p_ctrl->do_dummy_read     = false;
        p_ctrl->notify_request    = true;

        /* Register the TX buffer/direction now, then put the first byte out. */
        (void) R_IIC_SLAVE_Write(&g_i2c_slave_ctrl, g_slave_tx_buf, BUF_LEN);

        /* Enable START/STOP/error detection (tail of the original initiate_transaction). */
        p_ctrl->p_reg->ICSR2 &= (uint8_t) ~(ICSR2_STOP_BIT | ICSR2_START_BIT);
        p_ctrl->p_reg->ICIER  = (uint8_t) (IIC_STR_EN_BIT | IIC_STP_EN_BIT | IIC_TMO_EN_BIT |
                                           IIC_ALD_EN_BIT | IIC_NAK_EN_BIT | IIC_RXI_EN_BIT | IIC_TXI_EN_BIT);
        p_ctrl->start_interrupt_enabled = true;
    }

    if (IIC_SLAVE_TRANSFER_DIR_MASTER_READ_SLAVE_WRITE == p_ctrl->direction)
    {
        if (p_ctrl->total == p_ctrl->loaded)         /* 末字节已发出，等 master NACK/ACK */
        {
            R_BSP_IrqStatusClear(p_ctrl->p_cfg->tei_irq);
            NVIC_ClearPendingIRQ(p_ctrl->p_cfg->tei_irq);
            p_ctrl->p_reg->ICIER_b.TEIE = 1U;
        }
        else                                         /* 写数据，同时释放 SCL */
        {
            p_ctrl->p_reg->ICDRT = p_ctrl->p_buff[p_ctrl->loaded];
            p_ctrl->loaded++;
            p_ctrl->transaction_count++;

#if IIC_SLAVE_CFG_DTC_ENABLE                            /* 若保留 DTC 才要这段 */
            if ((NULL != p_ctrl->p_cfg->p_transfer_tx) && (p_ctrl->total > 2U) &&
                (false == p_ctrl->activation_on_txi) && (p_ctrl->loaded == 2U))
            {
                uint8_t volatile const * p_icdrt = &(p_ctrl->p_reg->ICDRT);
                p_ctrl->p_cfg->p_transfer_tx->p_api->reset(p_ctrl->p_cfg->p_transfer_tx->p_ctrl,
                                                           (void *) (p_ctrl->p_buff + 2U),
                                                           (uint8_t *) p_icdrt,
                                                           (uint16_t) (p_ctrl->total - 2U));
                p_ctrl->loaded             = p_ctrl->total;
                p_ctrl->transaction_count += (p_ctrl->total - 2U);
                p_ctrl->activation_on_txi  = true;
            }
#endif
        }
    }

    /* Restore context if RTOS is used */
    FSP_CONTEXT_RESTORE
}

#undef ICSR2_START_BIT
#undef ICSR2_STOP_BIT
#undef IIC_STR_EN_BIT
#undef IIC_STP_EN_BIT
#undef IIC_TMO_EN_BIT
#undef IIC_ALD_EN_BIT
#undef IIC_NAK_EN_BIT
#undef IIC_RXI_EN_BIT
#undef IIC_TXI_EN_BIT

#if BSP_TZ_SECURE_BUILD

FSP_CPP_HEADER
BSP_CMSE_NONSECURE_ENTRY void template_nonsecure_callable ();

/* Trustzone Secure Projects require at least one nonsecure callable function in order to build (Remove this if it is not required to build). */
BSP_CMSE_NONSECURE_ENTRY void template_nonsecure_callable ()
{

}
FSP_CPP_FOOTER

#endif
