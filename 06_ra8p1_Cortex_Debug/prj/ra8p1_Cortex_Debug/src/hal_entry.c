#include "hal_data.h"

#define CURRENT_LOG_LEVEL   LOG_LEVEL_DEBUG
#define LOG_USE
#include "log.h"

#define RTT_DSO         0
#define RTT_DSO_MODE    0
#define RTT_TIMESTAMP   0

#if RTT_DSO
#include <string.h>
#include "SEGGER_RTT/SEGGER_RTT.h"
#define SAMPLE_RATE_HZ       100   // 每10ms输出一次 = 100Hz采样率
#define SIGNAL_FREQ_HZ       16000 // 16kHz正弦波
#define PI                   3.14159265358979323846

// 全局变量：当前相位（弧度）
static float phase = 0.0f;
// 每次采样的相位增量：2 * PI * (信号频率 / 采样率)
static const float phase_increment = 2.0f * PI * (SIGNAL_FREQ_HZ / SAMPLE_RATE_HZ);

void rtt_send_float(float val) {
    uint8_t buf[5];
    buf[0] = 0x07;              // type_byte = float
    memcpy(&buf[1], &val, 4);   // 小端序4字节
    SEGGER_RTT_Write(1, buf, 5); // 通道1
}

// 如果选了固定格式"float (4字节)"，则不需要type_byte：
void rtt_send_float_fixed(float val) {
    int written = SEGGER_RTT_Write(1, &val, 4); // 直接发4字节
    if (written != 4) {
            SEGGER_RTT_printf(0, "Channel 1 write failed, written=%d\r\n", written);
    }
    SEGGER_RTT_printf(0, "Channel 0 test\n");
}

// 定时器中断回调（每10ms调用一次）
void on_10ms_timer(void) {
    // 计算正弦值，范围 -1.0 到 1.0
    float sin_value = sinf(phase);
    // 将正弦波映射到输出电压范围，例如 0~3.3V
    float output_voltage = 1.65f + 1.65f * sin_value; // 中心点1.65V，幅度1.65V
    rtt_send_float_fixed(output_voltage);


    // 更新相位，并限制在 0~2PI 范围内（防止累积误差）
    phase += phase_increment;
    if (phase >= 2.0f * PI) {
        phase -= 2.0f * PI;
    }
}

// 1. 在 SEGGER_RTT_Conf.h 中增加上行缓冲区数量
#define BUFFER_SIZE_UP (1024)           // 每个缓冲区大小
#define SEGGER_RTT_MAX_NUM_UP_BUFFERS (3)  // 至少 3（通道 0,1,2）

// 2. 在初始化代码中配置通道 1
static char ch1_buffer[128];  // 为通道 1 分配专用缓冲区


#endif



#if (1 == BSP_MULTICORE_PROJECT) && BSP_TZ_SECURE_BUILD
bsp_ipc_semaphore_handle_t g_core_start_semaphore =
{
    .semaphore_num = 0
};
#endif

/*******************************************************************************************************************//**
 * main() is generated by the RA Configuration editor and is used to generate threads if an RTOS is used.  This function
 * is called by main() when no RTOS is used.
 **********************************************************************************************************************/
void hal_entry(void)
{
#if USE_UART_PRINT
    g_uart8.p_api->open(g_uart8.p_ctrl, g_uart8.p_cfg);
#endif

#if USE_RTT_PRINT
    SEGGER_RTT_Init();
    // 测试通道0
    SEGGER_RTT_printf(0, "Channel 0 test\n");

#if RTT_DSO_MODE
#if RTT_TIMESTAMP
    // 配置通道1
    static char buf1[1024];
    SEGGER_RTT_ConfigUpBuffer(1, "JScope_t4u4", buf1, sizeof(buf1), SEGGER_RTT_MODE_NO_BLOCK_SKIP);
    // 配置通道2
    static char buf2[1024];
    SEGGER_RTT_ConfigUpBuffer(2, "JScope_t4u1", buf2, sizeof(buf2), SEGGER_RTT_MODE_NO_BLOCK_SKIP);
#else
    // 配置通道1
    static char buf1[1024];
    SEGGER_RTT_ConfigUpBuffer(1, "JScope_u4u4", buf1, sizeof(buf1), SEGGER_RTT_MODE_NO_BLOCK_SKIP);
    // 配置通道2
    static char buf2[1024];
    //SEGGER_RTT_ConfigUpBuffer(2, "JScope_u1", buf2, sizeof(buf2), SEGGER_RTT_MODE_NO_BLOCK_SKIP);
#endif

#endif//#if RTT_DSO_MODE

#endif//#if USE_RTT_PRINT

    /* TODO: add your own code here */
    LOG_INFO("date:%s\ntime:%s\nfile:%s\nfunc:%s,line:%d\nhello world!\n", __DATE__, __TIME__, __FILE__, __FUNCTION__, __LINE__);

    LOG_INFO("%s\n", FSP_VERSION_BUILD_STRING);

    R_BSP_SoftwareDelay(500, BSP_DELAY_UNITS_MILLISECONDS);

#if RTT_DSO_MODE
    g_gpt0.p_api->open(g_gpt0.p_ctrl, g_gpt0.p_cfg);
    g_gpt0.p_api->enable(g_gpt0.p_ctrl);
    g_gpt0.p_api->start(g_gpt0.p_ctrl);

    g_gpt1.p_api->open(g_gpt1.p_ctrl, g_gpt1.p_cfg);
    g_gpt1.p_api->enable(g_gpt1.p_ctrl);
    g_gpt1.p_api->start(g_gpt1.p_ctrl);

    while(1);
#endif//#if RTT_DSO_MODE


#if RTT_DSO
    //SEGGER_RTT_ConfigUpBuffer(1, "Waveform", ch1_buffer, sizeof(ch1_buffer), SEGGER_RTT_MODE_NO_BLOCK_SKIP);
    SEGGER_RTT_printf(0, "Channel 1 configured\r\n");

    while(RTT_DSO)
    {
        on_10ms_timer();
        R_BSP_SoftwareDelay(1000, BSP_DELAY_UNITS_MILLISECONDS);
    }
#endif

    static uint32_t buf[2000] = {0};
    memset(buf, 0x31, 2000);
    buf[1999] = 0;

    while(1)
    {
#if USE_UART_PRINT
        LOG_INFO("use uart print  while(1) loop\n");
#endif

#if USE_RTT_PRINT

        for(uint8_t i = 0; i < 20; i++)
        {
        LOG_INFO("use rtt print  while(1) loop %d......................................\n", i);
        }
#endif

        static bool level = 0;
        R_IOPORT_PinWrite(&g_ioport_ctrl, BSP_IO_PORT_00_PIN_12, level=!level);

        R_BSP_SoftwareDelay(1000, BSP_DELAY_UNITS_MILLISECONDS);
    }



    /* Wake up 2nd core if this is first core and we are inside a multicore project. */
#if (0 == _RA_CORE) && (1 == BSP_MULTICORE_PROJECT) && !BSP_TZ_NONSECURE_BUILD

#if BSP_TZ_SECURE_BUILD
    /* Take semaphore so 2nd core can clear it */
    R_BSP_IpcSemaphoreTake(&g_core_start_semaphore);
#endif

    R_BSP_SecondaryCoreStart();

#if BSP_TZ_SECURE_BUILD
    /* Wait for 2nd core to start and clear semaphore */
    while(FSP_ERR_IN_USE == R_BSP_IpcSemaphoreTake(&g_core_start_semaphore))
    {
        ;
    }
#endif
#endif

#if (1 == _RA_CORE) && (1 == BSP_MULTICORE_PROJECT) && BSP_TZ_SECURE_BUILD
    /* Signal to 1st core that 2nd core has started */
    R_BSP_IpcSemaphoreGive(&g_core_start_semaphore);
#endif

#if BSP_TZ_SECURE_BUILD
    /* Enter non-secure code */
    R_BSP_NonSecureEnter();
#endif
}

volatile uint32_t global_hw_tick = 0;

#pragma pack(push, 1)
typedef struct {
    uint32_t hw_timestamp; // t4: 硬件时间戳，例如来自一个1MHz的自由运行计数器
    uint32_t value;        // u4: 采样值 (针对CH1)
} JScopePacket_u4;

typedef struct {
    uint32_t hw_timestamp; // t4: 硬件时间戳
    uint8_t  value;        // u1: 采样值 (针对CH2)
} JScopePacket_u1;
#pragma pack(pop)

static volatile uint32_t temp1 = 0;
static volatile uint32_t temp2 = 0;
void g_gpt0CB(timer_callback_args_t *p_args)
{
    if(p_args->event == TIMER_EVENT_CYCLE_END)
    {
#if RTT_TIMESTAMP
        uint32_t now_tick = global_hw_tick;

        // 准备并发送CH1数据
        JScopePacket_u4 pkt1;
        pkt1.hw_timestamp = now_tick;
        pkt1.value = (temp1 == 100) ? 0 : 100;
        SEGGER_RTT_Write(1, &pkt1, sizeof(pkt1));

        // 准备并发送CH2数据
        JScopePacket_u1 pkt2;
        pkt2.hw_timestamp = now_tick;
        pkt2.value = (temp2 == 90) ? 10 : 90;
        SEGGER_RTT_Write(2, &pkt2, sizeof(pkt2));

        temp1 = pkt1.value;
        temp2 = pkt2.value;
#else
//        temp1 = (temp1 == 100) ? 0 : 100;
//        SEGGER_RTT_Write(1, &temp1, 4); // 通道1
//
//        temp2 = (temp2 == 90) ? 10 : 90;
//        SEGGER_RTT_Write(2, &temp2, 1); // 通道2

        // 一个通道,一次发送所有数据
#pragma pack(push, 1)  // 开始1字节对齐
        typedef struct {
            uint32_t ch1;
            uint32_t ch2;
            // 可以扩展更多通道
        } MultiChannelData_t;
#pragma pack(pop)       // 恢复默认对齐

        MultiChannelData_t data;

        temp1 = (temp1 == 100) ? 0 : 100;
        temp2 = (temp2 == 90) ? 10 : 90;
        data.ch1 = temp1;
        data.ch2 = temp2;
        SEGGER_RTT_Write(1, &data, sizeof(data));
#endif
    }
}

void g_gpt1CB(timer_callback_args_t *p_args)
{
    if(p_args->event == TIMER_EVENT_CYCLE_END)
    {
        global_hw_tick++;
    }
}


#if BSP_TZ_SECURE_BUILD

FSP_CPP_HEADER
BSP_CMSE_NONSECURE_ENTRY void template_nonsecure_callable ();

/* Trustzone Secure Projects require at least one nonsecure callable function in order to build (Remove this if it is not required to build). */
BSP_CMSE_NONSECURE_ENTRY void template_nonsecure_callable ()
{

}
FSP_CPP_FOOTER

#endif
