#include "hal_data.h"

#define RX_MAX      128
uint8_t uart0_dma_rx_data[RX_MAX] = {0};

#if (1 == BSP_MULTICORE_PROJECT) && BSP_TZ_SECURE_BUILD
bsp_ipc_semaphore_handle_t g_core_start_semaphore =
{
    .semaphore_num = 0
};
#endif


fsp_err_t R_SCI_B_UART_Write_DMA (uart_ctrl_t * const p_api_ctrl, uint8_t const * const p_src, uint16_t const bytes)
{
    fsp_err_t err = FSP_SUCCESS;

    sci_b_uart_instance_ctrl_t * p_ctrl = (sci_b_uart_instance_ctrl_t *) p_api_ctrl;

    //Before initiating DMA transfer, must be clear it first.
    R_ICU->IELSR[SCI0_TXI_IRQn] = 0U;

    p_ctrl->p_reg->CCR0 &= (uint32_t) ~(R_SCI_B0_CCR0_TIE_Msk | R_SCI_B0_CCR0_TEIE_Msk);
    /* Disable transmission */
    p_ctrl->p_reg->CCR0 &= (uint32_t) ~(R_SCI_B0_CCR0_TE_Msk);

    //dma config
    g_transfer0_dma_uart0_tx.p_cfg->p_info->p_src = (void*)&p_src[0];
    g_transfer0_dma_uart0_tx.p_cfg->p_info->p_dest = (void*)&R_SCI_B0->TDR;
    g_transfer0_dma_uart0_tx.p_cfg->p_info->length = bytes;

    err = g_transfer0_dma_uart0_tx.p_api->reconfigure(g_transfer0_dma_uart0_tx.p_ctrl, g_transfer0_dma_uart0_tx.p_cfg->p_info);

    /* Set TE and TIE bits simultaneously by single instruction to enable TIE interrupt.
     * See "Serial Data Transmission in Asynchronous Mode" in the SCI section of the relevant
     * hardware manual. */
    p_ctrl->p_reg->CCR0 |= (uint32_t) (R_SCI_B0_CCR0_TE_Msk | R_SCI_B0_CCR0_TIE_Msk);

    return err;

}

fsp_err_t R_SCI_B_UART_Read_DMA (uart_ctrl_t * const p_api_ctrl, uint8_t const * const p_dest, uint16_t const bytes)
{
    fsp_err_t err = FSP_SUCCESS;

    sci_b_uart_instance_ctrl_t * p_ctrl = (sci_b_uart_instance_ctrl_t *) p_api_ctrl;

    //Before initiating DMA transfer, must be clear it first.
    R_ICU->IELSR[SCI0_RXI_IRQn] = 0U;

    p_ctrl->p_reg->CCR0 &= (uint32_t) ~(R_SCI_B0_CCR0_RE_Msk | R_SCI_B0_CCR0_RIE_Msk);

    //dma config
    g_transfer1_dma_uart0_rx.p_cfg->p_info->p_src = (void*)&R_SCI_B0->RDR;
    g_transfer1_dma_uart0_rx.p_cfg->p_info->p_dest = (void*)&p_dest[0];
    g_transfer1_dma_uart0_rx.p_cfg->p_info->length = bytes;

    err = g_transfer1_dma_uart0_rx.p_api->reconfigure(g_transfer1_dma_uart0_rx.p_ctrl, g_transfer1_dma_uart0_rx.p_cfg->p_info);

    p_ctrl->p_reg->CCR0 |= (uint32_t) (R_SCI_B0_CCR0_RE_Msk | R_SCI_B0_CCR0_RIE_Msk);

    return err;

}

/*******************************************************************************************************************//**
 * main() is generated by the RA Configuration editor and is used to generate threads if an RTOS is used.  This function
 * is called by main() when no RTOS is used.
 **********************************************************************************************************************/
void hal_entry(void)
{
    /* TODO: add your own code here */
    uint8_t test0[] = "helloworld\n";
    g_uart0.p_api->open(g_uart0.p_ctrl, g_uart0.p_cfg);
    R_SCI_B_UART_Write(g_uart0.p_ctrl, test0, strlen(test0));
    R_BSP_SoftwareDelay(1, BSP_DELAY_UNITS_SECONDS);

    g_timer0.p_api->open(g_timer0.p_ctrl, g_timer0.p_cfg);
    g_timer0.p_api->enable(g_timer0.p_ctrl);
    //g_timer0.p_api->start(g_timer0.p_ctrl);

    g_elc.p_api->open(g_elc.p_ctrl, g_elc.p_cfg);
    g_elc.p_api->enable(g_elc.p_ctrl);

    g_transfer0_dma_uart0_tx.p_api->open(g_transfer0_dma_uart0_tx.p_ctrl, g_transfer0_dma_uart0_tx.p_cfg);
    g_transfer0_dma_uart0_tx.p_api->enable(g_transfer0_dma_uart0_tx.p_ctrl);

    g_transfer1_dma_uart0_rx.p_api->open(g_transfer1_dma_uart0_rx.p_ctrl, g_transfer1_dma_uart0_rx.p_cfg);
    g_transfer1_dma_uart0_rx.p_api->enable(g_transfer1_dma_uart0_rx.p_ctrl);

    uint8_t test1[] = "Test ra8p1 uart dma recv volatile string\n";
    R_SCI_B_UART_Write_DMA(g_uart0.p_ctrl, test1, strlen(test1));
    R_SCI_B_UART_Read_DMA(g_uart0.p_ctrl, uart0_dma_rx_data, RX_MAX);

    while(1)
    {
        static bool level = 0;
        R_IOPORT_PinWrite (&IOPORT_CFG_CTRL, USER_LED_GREEN, level = !level);
        R_BSP_SoftwareDelay(1, BSP_DELAY_UNITS_SECONDS);
    }
    /* Wake up 2nd core if this is first core and we are inside a multicore project. */
#if (0 == _RA_CORE) && (1 == BSP_MULTICORE_PROJECT) && !BSP_TZ_NONSECURE_BUILD

#if BSP_TZ_SECURE_BUILD
    /* Take semaphore so 2nd core can clear it */
    R_BSP_IpcSemaphoreTake(&g_core_start_semaphore);
#endif

    R_BSP_SecondaryCoreStart();

#if BSP_TZ_SECURE_BUILD
    /* Wait for 2nd core to start and clear semaphore */
    while(FSP_ERR_IN_USE == R_BSP_IpcSemaphoreTake(&g_core_start_semaphore))
    {
        ;
    }
#endif
#endif

#if (1 == _RA_CORE) && (1 == BSP_MULTICORE_PROJECT) && BSP_TZ_SECURE_BUILD
    /* Signal to 1st core that 2nd core has started */
    R_BSP_IpcSemaphoreGive(&g_core_start_semaphore);
#endif

#if BSP_TZ_SECURE_BUILD
    /* Enter non-secure code */
    R_BSP_NonSecureEnter();
#endif
}


void g_timer0CB(timer_callback_args_t *p_args)
{
    if(p_args->event == TIMER_EVENT_CYCLE_END)
    {
        transfer_properties_t p_info;

        R_DMAC_InfoGet(g_transfer1_dma_uart0_rx.p_ctrl, &p_info);

        R_SCI_B_UART_Write_DMA(g_uart0.p_ctrl, uart0_dma_rx_data, (uint16_t)(RX_MAX - p_info.transfer_length_remaining));


        R_SCI_B_UART_Read_DMA(g_uart0.p_ctrl, uart0_dma_rx_data, RX_MAX);
    }

}
void g_uart0CB (uart_callback_args_t * p_args)
{
    switch (p_args->event)
    {
        case UART_EVENT_RX_CHAR:
        {
            /* 把串口接收到的数据发送回去 */
            R_SCI_B_UART_Write(&g_uart0_ctrl, (uint8_t *)&(p_args->data), 1);
            break;
        }
        case UART_EVENT_TX_DATA_EMPTY:
        {

            break;
        }
        default:
            break;
    }
}

void g_transfer0_dma_uart0_txCB(transfer_callback_args_t *p_args)
{

}

void g_transfer1_dma_uart0_rxCB(transfer_callback_args_t *p_args)
{

}
#if BSP_TZ_SECURE_BUILD

FSP_CPP_HEADER
BSP_CMSE_NONSECURE_ENTRY void template_nonsecure_callable ();

/* Trustzone Secure Projects require at least one nonsecure callable function in order to build (Remove this if it is not required to build). */
BSP_CMSE_NONSECURE_ENTRY void template_nonsecure_callable ()
{

}
FSP_CPP_FOOTER

#endif
